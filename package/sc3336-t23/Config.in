## package/sc3336-t23/Config.in
```kconfig
config BR2_PACKAGE_SC3336_T23
	bool "sc3336-t23"
	depends on BR2_LINUX_KERNEL
	select BR2_PACKAGE_INGENIC_OPENSDK
	help
	  SmartSens SC3336 (3 MP, MIPI) sensor for Ingenic T23 on the
	  OpenIPC kernel, which ingenic-osdrv-t23 does not cover.

	  The driver source and the ISP tuning file (sc3336-t23.bin,
	  format 2.20, same as OpenIPC's other T23 tuning files) come
	  from thingino's ingenic-sdk (GPL-2.0+); only the includes are
	  changed so it builds against openingenic's ISP headers.

	  Installs sensor_sc3336_t23.ko, /etc/sensor/sc3336.yaml,
	  /etc/sensor/sc3336-t23.bin and its module options.

	  Ingenic's sensor prober (sinfo) does not know this chip, so the
	  device must set "fw_setenv sensor sc3336" for load_ingenic.
```

## package/tmi8152-motor/Config.in
```kconfig
config BR2_PACKAGE_TMI8152_MOTOR
	bool "tmi8152-motor"
	depends on BR2_LINUX_KERNEL
	select BR2_PACKAGE_MAJESTIC_WEBUI_PTZ if BR2_PACKAGE_MAJESTIC_WEBUI
	help
	  Pan/tilt and IR-cut driver for the TMI8150/TMI8152 SPI stepper
	  and H-bridge driver (TP-Link Tapo C210 v3, Ingenic T23N), from
	  https://github.com/sstepansky/tmi8152-spi-dev plus the two fixes
	  carried by the C210 thingino build (commit the measured position
	  after a move; tilt inverted by default on the C210).

	  Installs:
	  - tmi8152_spi_dev.ko: SPI chip driver, /dev/tmi8152_ir_cut
	    (write '1' = filter in / day, '0' = filter out / night)
	  - extra/motor.ko: /dev/motor with the Ingenic motor ioctls
	  - tmi-ptz: small CLI for /dev/motor using this driver's structs

	  Turns on the kernel's SPI0 controller (pins PB27-30), which the
	  T23 generic kernel config leaves off. The chip is powered by a
	  board GPIO the device profile has to raise before loading.
```
